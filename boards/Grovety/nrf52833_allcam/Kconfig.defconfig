## boards/Grovety/nrf52833_allcam/Kconfig.defconfig
```kconfig
# Copyright (c) 2019 Nordic Semiconductor ASA
# SPDX-License-Identifier: Apache-2.0

if BOARD_NRF52833_ALLCAM

config BT_CTLR
	default BT

endif # BOARD_NRF52833_ALLCAM
```

## boards/Grovety/nrf52833_allcam/Kconfig.nrf52833_allcam
```kconfig
# Copyright (c) 2019 Nordic Semiconductor ASA
# SPDX-License-Identifier: Apache-2.0

config BOARD_NRF52833_ALLCAM
	select SOC_NRF52833_QIAA
```
